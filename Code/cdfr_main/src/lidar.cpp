/*
 __ _            __            _        _   
/ _\ | ___   _  /__\ ___   ___| | _____| |_ 
\ \| |/ / | | |/ \/// _ \ / __| |/ / _ \ __|
_\ \   <| |_| / _  \ (_) | (__|   <  __/ |_ 
\__/_|\_\\__, \/ \_/\___/ \___|_|\_\___|\__|
         |___/                                                            
*/

/*  Lidar.cpp    */

#include <Arduino.h>
#include "../include/lidar.hpp"

const uint8_t Lidar::CrcTable[256] = {
    0x00, 0x4d, 0x9a, 0xd7, 0x79, 0x34, 0xe3, 0xae, 0xf2, 0xbf, 0x68, 0x25,
    0x8b, 0xc6, 0x11, 0x5c, 0xa9, 0xe4, 0x33, 0x7e, 0xd0, 0x9d, 0x4a, 0x07,
    0x5b, 0x16, 0xc1, 0x8c, 0x22, 0x6f, 0xb8, 0xf5, 0x1f, 0x52, 0x85, 0xc8,
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    0x7f, 0x32, 0xe5, 0xa8
};

Lidar::Lidar(HardwareSerial& serialPort, int rxPin, long baudRate)
    : serial(serialPort),
      rxPin(rxPin),
      speed(0),
      startAngle(0),
      endAngle(0),
      timestamp(0) {
    for (int i = 0; i < 12; i++) {
        distances[i] = 0;
        intensities[i] = 0;
    }
}

Lidar::~Lidar() {
}

bool Lidar::init() {
    serial.begin(230400, SERIAL_8N1, rxPin, -1);  // RX on specified pin, TX not used
    return true;  // No hardware check, assume success
}

bool Lidar::update() {
    if (serial.available() < BUFFER_SIZE * 2) {
        return false;  // Wait for more data
    }

    // Synchronization: Look for header (0x54, 0x2C)
    while (serial.available() >= BUFFER_SIZE) {
        if (serial.read() == 0x54) {
            if (serial.peek() == 0x2C) {
                serial.read();  // Consume 0x2C
                buffer[0] = 0x54;
                buffer[1] = 0x2C;
                break;
            }
        }
    }

    // Read remaining 45 bytes (total 47 with header)
    size_t bytesRead = serial.readBytes(buffer + 2, BUFFER_SIZE - 2);
    if (bytesRead != BUFFER_SIZE - 2) {
        return false;  // Incomplete packet
    }

    uint8_t calculatedCRC = calculateCrc8(buffer, BUFFER_SIZE - 1);
    if (calculatedCRC == buffer[BUFFER_SIZE - 1]) {
        byte verLen = buffer[1];
        if (verLen != 0x2C) {
            return false;  // Invalid VerLen
        }

        // Parse packet
        speed = (buffer[3] << 8) | buffer[2];
        startAngle = (buffer[5] << 8) | buffer[4];

        for (int i = 0; i < 12; i++) {
            int offset = 6 + i * 3;
            distances[i] = (buffer[offset + 1] << 8) | buffer[offset];
            intensities[i] = buffer[offset + 2];
        }

        endAngle = (buffer[43] << 8) | buffer[42];
        timestamp = (buffer[45] << 8) | buffer[44];

        return true;  // Valid packet processed
    }

    return false;  // CRC invalid
}

uint8_t Lidar::calculateCrc8(uint8_t* data, uint8_t len) {
    uint8_t crc = 0;
    for (uint16_t i = 0; i < len; i++) {
        crc = CrcTable[(crc ^ data[i]) & 0xff];
    }
    return crc;
}

bool Lidar::tooClose() {
    for (int i = 0; i < 12; i++) {
        if (distances[i] > minValidDist && distances[i] < thresholdDist) {
            return true;
        }
    }
    return false;
}